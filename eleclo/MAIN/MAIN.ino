#include "BluetoothSerial.h"
#include <FastLED.h>

//#define LED_N 1760
#define LED_N 1280
#define pixels_front_num 256
#define pixels_arm_num 240
#define FRONT_1 4
#define FRONT_2 26
#define FRONT_3 27
#define FRONT_4 32
#define FRONT_5 33

#define ARM_1 23
#define ARM_2 19

#define BRIGHTNESS 15

#define format_size 6000

BluetoothSerial SerialBT;

CRGBArray<pixels_front_num> front_1;
CRGBArray<pixels_front_num> front_2;
CRGBArray<pixels_front_num> front_3;
CRGBArray<pixels_front_num> front_4;
CRGBArray<pixels_front_num> front_5;
CRGBArray<pixels_arm_num> arm_1;
CRGBArray<pixels_arm_num> arm_2;

byte RGB_data[format_size] = {
  0, 0, 0, 0, 0, 0, 0, 0, 0, 0, 0, 0,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 0, 
};


void led_change();

typedef struct led
{
  byte R;
  byte G;
  byte B;
} LED;

LED matrix[LED_N];
unsigned int  k = 0, locate = 0,i;

void setup() {
  // put your setup code here, to run once:
  SerialBT.begin("115200");
  SerialBT.begin("MAIN_kaki");

  FastLED.addLeds<NEOPIXEL, FRONT_1>(front_1, pixels_front_num);
  FastLED.addLeds<NEOPIXEL, FRONT_2>(front_2, pixels_front_num);
  FastLED.addLeds<NEOPIXEL, FRONT_3>(front_3, pixels_front_num);
  FastLED.addLeds<NEOPIXEL, FRONT_4>(front_4, pixels_front_num);
  FastLED.addLeds<NEOPIXEL, FRONT_5>(front_5, pixels_front_num);
  FastLED.addLeds<NEOPIXEL, ARM_1>(arm_1, pixels_arm_num);
  FastLED.addLeds<NEOPIXEL, ARM_2>(arm_2, pixels_arm_num);

  FastLED.setBrightness(BRIGHTNESS);

  for (i = 0; i < LED_N * 3; i++)
    {
      if (( i % 3 ) == 0)
      {
        matrix[locate].R = RGB_data[i];
      }
      else if ( ( i % 3 ) == 1)
      {
        matrix[locate].G = RGB_data[i];
      }
      else if ( ( i % 3 ) == 2)
      {
        matrix[locate].B = RGB_data[i];
        locate++;

      }
    }
  delay(500);
  led_change();
  locate = 0;
  FastLED.clear();
  

}

void loop() {
  // put your main code here, to run repeatedly:
  if (SerialBT.available()) //bluetoothからデータが送信され、バッファに入る
  {
    byte tmp;

    tmp = SerialBT.read();

    if ((k % 3) == 0)matrix[locate].R = tmp;
    else if ((k % 3) == 1)matrix[locate].G = tmp;
    else if ((k % 3) == 2)
    {
      matrix[locate].B = tmp;
      locate++;
    }

    //debug start
    if (k % 3 == 0) SerialBT.println(matrix[locate].R);
    if (k % 3 == 1) SerialBT.println(matrix[locate].G);
    if (k % 3 == 2) SerialBT.println(matrix[locate - 1].B);
    //debug end

    k++;

    if (locate == LED_N)
    {
      led_change();
      locate = 0;
      k = 0;
    }
  }
}


void led_change() 
{
  Serial.println("LEDに色をセットします");
  FastLED.clear();
  int  awase, udeawase = 29;
  for (i = 0; i < LED_N; i++)
  {
    if (i % 32 == 0)awase = 31;
    if (((i - 1280) % 30) == 0)udeawase = 29;
    if (0 <= i && i < 256) //256番目のピクセルまではフロントの一つ目のパネルまで
    {

      if (((i / 32) % 2) == 0) //((i/32) % 2)==0)
      {
        front_1[i + awase] = CRGB(matrix[i].R, matrix[i].G, matrix[i].B);
        awase -= 2;

      }
      else
      {
        front_1[i] = CRGB(matrix[i].R, matrix[i].G, matrix[i].B);
      }
    }
    else if (256 <= i && i < 512) //二つ目のパネル
    {
      if (((i / 32) % 2) == 0) //((i/32) % 2)==0)
      {
        front_2[i + awase - 256] = CRGB(matrix[i].R, matrix[i].G, matrix[i].B);
        awase -= 2;

      }
      else
      {
        front_2[i - 256] = CRGB(matrix[i].R, matrix[i].G, matrix[i].B);
      }
    }
    else if (512 <= i && i < 768) //三つ目のパネル
    {
      if (((i / 32) % 2) == 0) //((i/32) % 2)==0)
      {
        front_3[i + awase - 512] = CRGB(matrix[i].R, matrix[i].G, matrix[i].B);
        awase -= 2;

      }
      else
      {
        front_3[i - 512] = CRGB(matrix[i].R, matrix[i].G, matrix[i].B);
      }
    }
    else if (768 <= i && i < 1024) //4つ目のパネル
    {
      if (((i / 32) % 2) == 0) //((i/32) % 2)==0)
      {
        front_4[i + awase - 768] = CRGB(matrix[i].R, matrix[i].G, matrix[i].B);
        awase -= 2;

      }
      else
      {
        front_4[i - 768] = CRGB(matrix[i].R, matrix[i].G, matrix[i].B);
      }
    }
    else if (1024 <= i && i < 1280) //五つ目のパネル
    {
      if (((i / 32) % 2) == 0) //((i/32) % 2)==0)
      {
        front_5[i + awase - 1024] = CRGB(matrix[i].R, matrix[i].G, matrix[i].B);
        awase -= 2;

      }
      else
      {
        front_5[i - 1024] = CRGB(matrix[i].R, matrix[i].G, matrix[i].B);
      }
    }
    else if (1280 <= i && i < 1520) //腕の一つ
    {
      if (((i - 1280) / 30) % 2 == 0)
      {
        arm_1[i - 1280] = CRGB(matrix[i].R, matrix[i].G, matrix[i].B);
      }
      else
      {
        arm_1[udeawase + i - 1280] = CRGB(matrix[i].R, matrix[i].G, matrix[i].B);
        udeawase -= 2;
      }
    }
    else if (1520 <= i && i < 1760) //腕の一つ
    {
      if (((i - 1520) / 30) % 2 == 0)
      {
        arm_2[ i - 1520] = CRGB(matrix[i].R, matrix[i].G, matrix[i].B);
      }
      else
      {
        arm_2[udeawase + i - 1520] = CRGB(matrix[i].R, matrix[i].G, matrix[i].B);
        udeawase -= 2;
      }

    }
  }
  FastLED.show();
  FastLED.delay(8);
  Serial.println("LEDに色をセットしました");
}
